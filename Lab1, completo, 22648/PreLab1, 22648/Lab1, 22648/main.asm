;UNIVERSIDAD DEL VALLE DE GUATEMALA
;IE2023: PROGRAMACIÓN DE MICROCONTROLADORES
;Laboratorio1.asm
;AUTOR: Eber Alexander Cuxé Tan
;PROYECTO: Contadores binarios de 4 bits
;HARDWARE: ATMEGA328P
;CREADO: 30/01/2024
;ÚLTIMA MODIFICACIÓN: 30/01/2024 17:19

.INCLUDE "M328PDEF.INC"
.CSEG
.ORG 0X00

;STACK POINTER SPL SPH
LDI R16, LOW(RAMEND)
OUT SPL, R16
LDI R17, HIGH(RAMEND)
OUT SPH, R17


SETUP:
	LDI R16, (1 << CLKPCE)	;PRESCALER ENABLE
	STS CLKPR, R16

	LDI R16, 0X03			;16MHz / 8
	STS CLKPR, R16			;FREC: 2MHz

	;ENCREASE BUTTON AND CARRY LED
	LDI R16, 0x1F			;SELECT PC0 - PC4 AS INPUT WITH PULL-UP ON
	OUT PORTC, R16			;SAVE SETTING OF PORT, DEFAULT, INPUTS (0)

	LDI R16, 0x20
	OUT DDRC, R16			;ALL PC0 - PC4 AS INPUT, AND PC5 OUTPUT

	;LEDS
	LDI R16, 0x3F
	OUT DDRB, R16			;SET PB0 - PB5 AS OUTPUT

	LDI R17, 0xFC			;SET PD2 - PD7 AS OUTPUT
	OUT DDRD, R17
	
	LDI R19, 0x00			;SET A VALUE FOR SHOWING
	LDI R20, 0x00
	LDI R23, 0x00


LOOP:
	CALL COUNTER1
	CALL COUNTER2
	RJMP LOOP


;*****SUBROUTINES*****
COUNTER1:
	IN R16, PINC			;READING THE ENTIRE REGISTER OF PORTC
	SBRS R16, PC0			;READING PC0, INCREASE, IF IT'S 1 SKIPS NEXT INSTR.
	RJMP INCREASE1			;CALLING INCREASE

	IN R17, PINC
	SBRS R17, PC1			;READING PC1, DECREASE, IF IT'S 1 SKIPS NEXT INSTR.
	RJMP DECREASE1
	OUT PORTB, R19			;SHOWS THE COUNTER1
	RET

COUNTER2:
	IN R21, PINC			;READING THE ENTIRE REGISTER OF PORTC
	SBRS R21, PC2			;READING PC0, INCREASE, IF IT'S 1 SKIPS NEXT INSTR.
	RJMP INCREASE2			;CALLING INCREASE

	IN R22, PINC
	SBRS R22, PC3			;READING PC1, DECREASE, IF IT'S 1 SKIPS NEXT INSTR.
	RJMP DECREASE2
	OUT PORTD, R23			;SHOWS THE COUNTER2
	RET

DELAYBOUNCE:
	LDI R16, 0			;IT WAITS 75 U. OF TIME
	LDI R17, 0
	
	DELAY:
		DEC R16				;DECREASE R16
		BRNE DELAY			;IF R16 IS NOT 0 RETURN TO DELAY
		DEC R17
		BRNE DELAY
	
	SBIS PINC, (PC1 & PC0 & PC2 & PC3)	;IT SKIPS NEXT INSTR. IF REGISTER IS 1
	RJMP DELAYBOUNCE
	RJMP LOOP

INCREASE1:
	CPI R19, 15				;COMPARE IF COUNT IS 15
	BREQ LOOP				;IF COUNT IS 15 RET TO LOOP AND DOESN'T INC 
	INC R19					;R19 EXCLUSIVE FOR COUNTING
	RJMP DELAYBOUNCE

DECREASE1:
	CPI R19, 0				;COMPARE IF COUNTER IS ZERO
	BREQ LOOP				;IF IT'S ZERO IT RETURNS TO LOOP AND DOESN´T DEC 
	DEC R19
	RJMP DELAYBOUNCE

INCREASE2:
	CPI R20, 15				;COMPARE IF COUNT IS 15
	BREQ LOOP				;IF COUNT IS 15 RET TO LOOP AND DOESN'T INC 
	INC R20					;R20 EXCLUSIVE FOR COUNTING
	CALL SHIFTL
	RJMP DELAYBOUNCE

DECREASE2:
	CPI R20, 0				;COMPARE IF COUNTER IS ZERO
	BREQ LOOP				;IF IT'S ZERO IT RETURNS TO LOOP AND DOESN´T DEC 
	DEC R20
	CALL SHIFTL
	RJMP DELAYBOUNCE

SHIFTL:
	MOV R23, R20
	LSL R23
	LSL R23
	RET