;UNIVERSIDAD DEL VALLE DE GUATEMALA
;IE2023: PROGRAMACIсN DE MICROCONTROLADORES
;Laboratorio1.asm
;AUTOR: Eber Alexander CuxИ Tan
;PROYECTO: Contador binario de 4 bits
;HARDWARE: ATMEGA328P
;CREADO: 30/01/2024
;зLTIMA MODIFICACIсN: 30/01/2024 17:19

.INCLUDE "M328PDEF.INC"
.CSEG
.ORG 0X00

;STACK POINTER SPL SPH
LDI R16, LOW(RAMEND)
OUT SPL, R16
LDI R17, HIGH(RAMEND)
OUT SPH, R17


SETUP:
	LDI R16, (1 << CLKPCE)	;PRESCALER ENABLE
	STS CLKPR, R16

	LDI R16, 0X03			;16MHz / 8
	STS CLKPR, R16			;FREC: 2MHz

	;ENCREASE BUTTON AND CARRY LED
	LDI R16, 0x1F			;SELECT PC0 - PC4 AS OUTPUT WITH PULL-UP ON
	OUT PORTC, R16			;SAVE SETTING OF PORT

	LDI R16, 0x20
	OUT DDRC, R16			;ALL PC0 - PC4 AS INPUT, AND PC5 OUTPUT

	;LEDS
	LDI R16, 0x3F
	OUT DDRB, R16			;SET PB0 - PB5 AS OUTPUT
	
	LDI R19, 0X00			;SET A VALUE FOR SHOWING


LOOP:
	IN R16, PINC			;READING THE ENTIRE REGISTER OF PORTC}
	SBRS R16, PC0			;READING PC0, INCREASE, IF IT'S 1 SKIPS NEXT INSTR.
	RJMP INCREASE			;CALLING INCREASE

	IN R17, PINC
	SBRS R17, PC1			;READING PC1, DECREASE, IF IT'S 1 SKIPS NEXT INSTR.
	RJMP DECREASE
	
	OUT PORTB, R19			;SHOWS THE COUNT
	RJMP LOOP


;*****SUBROUTINES*****
DELAYBOUNCE:
	LDI R16, 0			;IT WAITS 75 U. OF TIME
	LDI R17, 0
	DELAY:
		DEC R16				;DECREASE R16
		BRNE DELAY			;IF R16 IS NOT 0 RETURN TO DELAY
		DEC R17
		BRNE DELAY
	
	SBIS PINC, (PC1 & PC0)	;IT SKIPS NEXT INSTR. IF REGISTER IS 1
	RJMP DELAYBOUNCE
	RJMP LOOP

INCREASE:
	INC R19					;R19 EXCLUSIVE FOR COUNTING
	CPI R19, 15
	BREQ LOOP
	RJMP DELAYBOUNCE

DECREASE:
	DEC R19
	CPI R19, 0
	BREQ LOOP
	RJMP DELAYBOUNCE